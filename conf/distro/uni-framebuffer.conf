## conf/distro/uni-framebuffer.conf
```bitbake
# UNICLOUD Distro for FrameBuffer graphical backend.

require conf/distro/poky.conf

DISTRO = "unicloud-base"
DISTRO_NAME = "UNICLOUD Distro FrameBuffer"
SDK_VENDOR = "-unicloudsdk"

MAINTAINER = "Nguyen Van Huynh Y <ynguyen0404@gmail.com"

TARGET_VENDOR = "-unicloudfb"

DISTROOVERRIDES = "unicloudfb"

# Remove conflicting backends.

DISTRO_FEATURES:append = " pam systemd alsa bluez5 opengl usbgadget usbhost wifi bluetooth optee"
DISTRO_FEATURES:remove = " x11 wayland directfb vulkan"
VIRTUAL-RUNTIME_init_manager = "systemd"
DISTRO_FEATURES_BACKFILL_CONSIDERED = "sysvinit"
VIRTUAL-RUNTIME_initscripts = ""
```

## conf/distro/uni-x11.conf
```bitbake
# Rockchip DISTRO for X11 without Wayland

require conf/distro/poky.conf

DISTRO = "uni-x11"
DISTRO_NAME = "UNICLOUD Distro X11 Without Wayland"
SDK_VENDOR = "-unicloudsdk"
MAINTAINER = "Nguyen Van Huynh Y <ynvh@unicloud.com"
TARGET_VENDOR = "-unicloudx11"
DISTROOVERRIDES = "unicloudx11"

# Remove conflicting backends.
DISTRO_FEATURES:append = " x11 usbhost"
DISTRO_FEATURES:remove = " wayland directfb vulkan"


#DISTRO_FEATURES:append = " x11 pam systemd bluez5 opengl usbgadget usbhost wifi bluetooth"
#DISTRO_FEATURES:remove = " wayland directfb vulkan"
#VIRTUAL-RUNTIME_init_manager = "systemd"
#DISTRO_FEATURES_BACKFILL_CONSIDERED = "sysvinit"
#VIRTUAL-RUNTIME_initscripts = ""
```

## conf/distro/uni-xwayland.conf
```bitbake
# UNICLOUD Distro for FrameBuffer graphical backend.

require conf/distro/poky.conf

DISTRO = "unicloud-base"
DISTRO_NAME = "UNICLOUD Distro xwayland"
SDK_VENDOR = "-unicloudsdk"

MAINTAINER = "Nguyen Van Huynh Y <ynguyen0404@gmail.com"

TARGET_VENDOR = "-unicloudxwayland"

DISTROOVERRIDES = "unicloudxwayland"

# Remove conflicting backends.

DISTRO_FEATURES:append = " x11 wayland pam systemd vulkan alsa bluez5 opengl usbgadget usbhost wifi bluetooth"
DISTRO_FEATURES:remove = " directfb "
VIRTUAL-RUNTIME_init_manager = "systemd"
DISTRO_FEATURES_BACKFILL_CONSIDERED = "sysvinit"
VIRTUAL-RUNTIME_initscripts = ""
```

## conf/layer.conf
```bitbake
# We have a conf and classes directory, add to BBPATH
BBPATH .= ":${LAYERDIR}"

# We have recipes-* directories, add to BBFILES
BBFILES += "${LAYERDIR}/recipes-*/*/*.bb \
	${LAYERDIR}/recipes-*/*/*.bbappend"

BBFILE_COLLECTIONS += "unicloud"
BBFILE_PATTERN_unicloud = "^${LAYERDIR}/"
BBFILE_PRIORITY_unicloud = "7"

LAYERSERIES_COMPAT_unicloud = " hardknott zeus gatesgarth kirkstone"
```

## conf/machine/bluefin2.conf
```bitbake
#@TYPE: Machine
#@NAME: BLUEFIN2 Machine
#@SOC: i.MX6UL
#@DESCRIPTION: Machine configuration for BLUEFIN2
#@MAINTAINER: ThinhNguyen <nguyen.trong.thinh@styl.solutions>


include conf/machine/imx6ulevk.conf
include conf/machine/include/bluefin2-default-versions.inc

MACHINEOVERRIDES =. "mx6:mx6ul:imx6ulevk:"

MACHINE_FEATURES += " pci wifi bluetooth optee"

MACHINE_ESSENTIAL_EXTRA_RRECOMMENDS += "\
    kernel-modules \
    kernel-module-qca9377 \
"
IMAGE_FSTYPES += "wic.gz"
IMAGE_FSTYPES_remove = " wic.bz2"

# BOOT Script have error: hang at starting kernel 
#BOOT_SCRIPTS += "boot.scr:boot.scr"

#IMAGE_BOOT_FILES += "boot.scr"
IMAGE_BOOT_FILES += "uEnv.bin"
```

## conf/machine/doorphone.conf
```bitbake
#@TYPE: Machine
#@NAME: DOORPHONE Machine
#@SOC: Rockchip PX30
#@DESCRIPTION: Machine configuration for DOORPHONE
#@MAINTAINER: YNGUYEN <ynvh@unicloud.com>

include conf/machine/rockchip-px30-evb.conf
```

## conf/machine/huso.conf
```bitbake
#@TYPE: Machine
#@NAME: HUSO Machine
#@SOC: i.MX6Q
#@DESCRIPTION: Machine configuration for HUSO
#@MAINTAINER: Y Nguyen <nguyen.van.huynh.y@styl.solutions>


include conf/machine/imx6qsabresd.conf
include conf/machine/include/huso-default-versions.inc

MACHINEOVERRIDES =. "mx6:mx6dl:imx6qsabresd:"

MACHINE_FEATURES += " pci wifi bluetooth usbhost usbgadget screen rtc alsa acpi"

MACHINE_ESSENTIAL_EXTRA_RRECOMMENDS += "\
    kernel-modules \
    kernel-module-qca9377 \
"

IMAGE_FSTYPES += "ext4.gz.u-boot wic.gz"
IMAGE_FSTYPES_remove = " wic.bz2"

#KERNEL_DEVICETREE = "imx6dl-sabresd.dtb imx6dl-sabresd-ldo.dtb"

MACHINE_FEATURES_append = " optee"

UBOOT_CONFIG ??= "${@bb.utils.contains('MACHINE_FEATURES', 'optee', 'sd-optee', 'sd', d)}"
UBOOT_CONFIG[sd] = "mx6qsabresd_config,sdcard"
UBOOT_CONFIG[sata] = "mx6qsabresd_sata_config"
UBOOT_CONFIG[mfgtool] = "mx6qsabresd_config"
UBOOT_CONFIG[sd-optee] = "mx6qsabresd_optee_config,sdcard"

OPTEE_BIN_EXT = "6qsdb"

#IMAGE_BOOT_FILES += "boot.scr"
IMAGE_BOOT_FILES += "uEnv.bin"
```

## conf/machine/include/rk-default-versions.inc
```bitbake
#BSP default versions

PREFERRED_VERSION_linux-imx ?= "5.15%"
PREFERRED_VERSION_linux-imx ?= "5.15%"
```

## conf/machine/machine1.conf
```bitbake
#@TYPE: Machine
#@NAME: Board Machine
#@SOC: i.MX6S
#@DESCRIPTION: Machine configuration for ProjectName
#@MAINTAINER: Y Nguyen <ynguyen0404@gmail.com>


include conf/machine/imx6solosabresd.conf
include conf/machine/include/board-default-versions.inc

MACHINEOVERRIDES =. "mx6:mx6dl:imx6solosabresd:"

MACHINE_FEATURES += " pci wifi bluetooth"

MACHINE_ESSENTIAL_EXTRA_RRECOMMENDS += "\
    kernel-modules \
"

IMAGE_FSTYPES += "wic.gz"
IMAGE_FSTYPES:remove = " wic.bz2"

KERNEL_DEVICETREE = "imx6solo-doha.dtb"

MACHINE_FEATURES:append = " optee"

UBOOT_CONFIG ?= "${@bb.utils.contains('MACHINE_FEATURES', 'optee', 'sd-optee', 'sd', d)}"
UBOOT_CONFIG[sd] = "mx6solosabresd_config,sdcard"
UBOOT_CONFIG[mfgtool] = "mx6solosabresd_config"
UBOOT_CONFIG[sd-optee] = "dohasolo_optee_defconfig,sdcard"

IMAGE_BOOT_FILES += "boot.scr"
```

## conf/machine/machine2.conf
```bitbake
#@TYPE: Machine
#@NAME: ITFS Machine
#@SOC: i.MX8MQEVK
#@DESCRIPTION: Machine configuration for ITFS
#@MAINTAINER: YNGUYEN <nguyen.van.huynh.y@styl.solutions>


include conf/machine/imx8mq-evk.conf
include conf/machine/include/default-versions.inc

MACHINEOVERRIDES =. "mx8:mx8m:mx8mq:"

MACHINE_FEATURES += "pci wifi bluetooth"

MACHINE_ESSENTIAL_EXTRA_RRECOMMENDS += "\
    kernel-modules \
    linux-firmware-ax200-pcie \
"
#linux-firmware-ax200-pcie

MACHINE_ESSENTIAL_EXTRA_RRECOMMENDS_remove = " kernel-module-qca6174"

IMAGE_FSTYPES += "wic.gz"
IMAGE_FSTYPES_remove = " wic.bz2"
```

## conf/machine/machine3.conf
```bitbake
#@TYPE: Machine
#@NAME: Board Machine
#@SOC: i.MX6Q
#@DESCRIPTION: Machine configuration for ProjectName
#@MAINTAINER: Y Nguyen <ynguyen0404@gmail.com>


include conf/machine/imx6qsabresd.conf
include conf/machine/include/default-versions.inc

MACHINEOVERRIDES =. "mx6:mx6dl:imx6qsabresd:"

MACHINE_FEATURES += " pci wifi bluetooth usbhost usbgadget screen rtc alsa acpi"

MACHINE_ESSENTIAL_EXTRA_RRECOMMENDS += "\
    kernel-modules \
    kernel-module-qca9377 \
"

IMAGE_FSTYPES += "ext4.gz.u-boot wic.gz"
IMAGE_FSTYPES_remove = " wic.bz2"

#KERNEL_DEVICETREE = "imx6dl-sabresd.dtb imx6dl-sabresd-ldo.dtb"

MACHINE_FEATURES_append = " optee"

UBOOT_CONFIG ??= "${@bb.utils.contains('MACHINE_FEATURES', 'optee', 'sd-optee', 'sd', d)}"
UBOOT_CONFIG[sd] = "mx6qsabresd_config,sdcard"
UBOOT_CONFIG[sata] = "mx6qsabresd_sata_config"
UBOOT_CONFIG[mfgtool] = "mx6qsabresd_config"
UBOOT_CONFIG[sd-optee] = "mx6qsabresd_optee_config,sdcard"

OPTEE_BIN_EXT = "6qsdb"

#IMAGE_BOOT_FILES += "boot.scr"
IMAGE_BOOT_FILES += "uEnv.bin"
```

## conf/machine/machine4.conf
```bitbake
#@TYPE: Machine
#@NAME: Board Machine
#@SOC: i.MX6UL
#@DESCRIPTION: Machine configuration for ProjectName
#@MAINTAINER: Y Nguyen <ynguyen0404@gmail.com>


include conf/machine/imx6ulevk.conf
include conf/machine/include/default-versions.inc

MACHINEOVERRIDES =. "mx6:mx6ul:imx6ulevk:"

MACHINE_FEATURES += " pci wifi bluetooth optee"

MACHINE_ESSENTIAL_EXTRA_RRECOMMENDS += "\
    kernel-modules \
    kernel-module-qca9377 \
"
IMAGE_FSTYPES += "wic.gz"
IMAGE_FSTYPES:remove = " wic.bz2"

# BOOT Script have error: hang at starting kernel 
#BOOT_SCRIPTS += "boot.scr:boot.scr"

#IMAGE_BOOT_FILES += "boot.scr"
IMAGE_BOOT_FILES += "uEnv.bin"
```

## conf/machine/machine5.conf
```bitbake
#@TYPE: Machine
#@NAME: Board Machine
#@SOC: i.MX8Plus
#@DESCRIPTION: Machine configuration for ProjectName
#@MAINTAINER: Y Nguyen <ynguyen0404@gmail.com>


include conf/machine/imx8mqevk.conf
include conf/machine/include/default-versions.inc

MACHINEOVERRIDES =. "mx8:mx8m:mx8mq:"

MACHINE_FEATURES += "pci wifi bluetooth optee"

MACHINE_ESSENTIAL_EXTRA_RRECOMMENDS += "\
    kernel-modules \
    linux-firmware-ax200-pcie \
"
MACHINE_ESSENTIAL_EXTRA_RRECOMMENDS_remove = " kernel-module-qca6174"

IMAGE_FSTYPES += "wic.gz"
IMAGE_FSTYPES_remove = " wic.bz2"
```

## conf/machine/yellowfin5.conf
```bitbake
#@TYPE: Machine
#@NAME: YELLOWFIN5 Machine
#@SOC: i.MX8Plus
#@DESCRIPTION: Machine configuration for YELLOWFIN5
#@MAINTAINER: ThinhNguyen <nguyen.trong.thinh@styl.solutions>


include conf/machine/imx8mqevk.conf
include conf/machine/include/yellowfin5-default-versions.inc

MACHINEOVERRIDES =. "mx8:mx8m:mx8mq:"

MACHINE_FEATURES += "pci wifi bluetooth optee"

MACHINE_ESSENTIAL_EXTRA_RRECOMMENDS += "\
    kernel-modules \
    linux-firmware-ax200-pcie \
"
MACHINE_ESSENTIAL_EXTRA_RRECOMMENDS_remove = " kernel-module-qca6174"

IMAGE_FSTYPES += "wic.gz"
IMAGE_FSTYPES_remove = " wic.bz2"
```

## docs/sample/conf/local.conf
```bitbake
DISTRO = "uni-x11"
MACHINE = "doorphone"

#DL_DIR ?= "${TOPDIR}/downloads"
#SSTATE_DIR ?= "${TOPDIR}/sstate-cache"
#TMPDIR = "${TOPDIR}/tmp"

PACKAGE_CLASSES ?= "package_rpm"

EXTRA_IMAGE_FEATURES ?= "debug-tweaks"
USER_CLASSES ?= "buildstats"

PATCHRESOLVE = "noop"
BB_DISKMON_DIRS ??= "\
    STOPTASKS,${TMPDIR},1G,100K \
    STOPTASKS,${DL_DIR},1G,100K \
    STOPTASKS,${SSTATE_DIR},1G,100K \
    STOPTASKS,/tmp,100M,100K \
    HALT,${TMPDIR},100M,1K \
    HALT,${DL_DIR},100M,1K \
    HALT,${SSTATE_DIR},100M,1K \
    HALT,/tmp,10M,1K"

PACKAGECONFIG:append:pn-qemu-system-native = " sdl"
CONF_VERSION = "2"

LICENSE_FLAGS_ACCEPTED = "commercial"
```
